## main/Kconfig.projbuild
```kconfig
menu "Firmware Variant"

config THERMOCOUPLE_ENABLED
    bool "Enable MAX6675 thermocouple sensor"
    default n
    help
        Enables the MAX6675 SPI thermocouple driver, thermocouple config
        fields, and thermocouple alarm thresholds. Disable for the standard
        (temperature + humidity only) variant.

config OLED_ENABLED
    bool "Enable OLED display"
    default y
    help
        Enables the SSD1306 OLED display driver and display task.
        Disable for headless hardware variants.

config WIFI_ENABLED
    bool "Enable WiFi, web server and OTA"
    default y
    help
        Enables WiFi manager, HTTP web server, auto-updater, and NTP clock sync.
        Disable for variants without network connectivity.

config FUOTA_ENABLED
    bool "Enable LoRaWAN FUOTA (Class C multicast + delta-OTA)"
    default y
    depends on WIFI_ENABLED
    help
        Enables Firmware Update Over The Air via LoRaWAN multicast
        (TS004/TS005/TS006 + esp_delta_ota). Requires dual OTA
        partitions — disabled on 2MB SKUs via sdkconfig.defaults.2mb.
        Depends on WIFI_ENABLED because firmware version reporting
        and session state assume the full networking stack.

endmenu
```
